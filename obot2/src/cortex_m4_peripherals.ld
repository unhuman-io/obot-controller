PROVIDE_HIDDEN(SCS_BASE_address = 0xE000E000);
PROVIDE_HIDDEN(ITM_BASE_address = 0xE0000000);
PROVIDE_HIDDEN(DWT_BASE_address = 0xE0001000);
PROVIDE_HIDDEN(TPI_BASE_address = 0xE0040000);
PROVIDE_HIDDEN(CoreDebug_BASE_address = 0xE000EDF0);
PROVIDE_HIDDEN(SysTick_BASE_address = SCS_BASE_address + 0x0010);
PROVIDE_HIDDEN(NVIC_BASE_address = SCS_BASE_address + 0x0100);
PROVIDE_HIDDEN(SCB_BASE_address = SCS_BASE_address + 0x0D00);
PROVIDE(SCnSCB_address = SCS_BASE_address);
PROVIDE(SCB_address = SCB_BASE_address);
PROVIDE(SysTick_address = SysTick_BASE_address);
PROVIDE(NVIC_address = NVIC_BASE_address);
PROVIDE(ITM_address = ITM_BASE_address);
PROVIDE(DWT_address = DWT_BASE_address);
PROVIDE(TPI_address = TPI_BASE_address);
PROVIDE(CoreDebug_address = CoreDebug_BASE_address);
PROVIDE_HIDDEN(FPU_BASE_address = SCS_BASE_address + 0x0F30);
PROVIDE(FPU_address = FPU_BASE_address);
