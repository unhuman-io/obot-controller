&elf_file="~/obot/obot-controller/build/llvm/obot3/config1-1.elf"

; STM32G564: Cortex-M33, 512K flash at 0x08000000 (2 banks, 8K sectors),
; 112K SRAM at 0x20000000. TRACE32 (R.2026.02) has no G5 support yet, so this
; is a generic Cortex-M33 setup with the flash declared by hand.
system.cpu stm32g474re
system.jtagclock 40MHz
SYStem.CONFIG.DEBUGPORTTYPE SWD

system.Option.EnReset OFF
system.Option.DUALPORT ON
system.mode attach
break

do ~~/demo/arm/flash/stm32g4xx.cmm PREPAREONLY CPU=STM32G474RE DUALPORT=0

flash.ReProgram all /Erase
data.load.elf &elf_file
flash.ReProgram off

Data.LOAD.elf &elf_file /DIFF
IF FOUND()
  PRINT "Verify error after FLASH programming"
ELSE
  PRINT "FLASH programming completed successfully"

system.Option.IMASKASM ON

SYStem.Up

; ITM over SWO at the 280 MHz PLL clock (see config1_rcc_clock_init)
itm.clock 170MHz
tpiu.PortSize SWV
tpiu.SWVPrescaler 1.
trace.TraceCLOCK 170MHz
itm.on
itm.DataTrace on
trace.autoinit.on

system.RESetTarget


list.auto

menu.addtool "Reset" "R" "system.resettarget"
