&elf_file="~/obot/obot-controller/obot_g474/build/motor_enc.elf"

reset

system.cpu stm32g474re
system.jtagclock 80MHz
SYStem.CONFIG.DEBUGPORTTYPE SWD
system.mode attach
break

do ~~/demo/arm/flash/stm32g4xx.cmm PREPAREONLY CPU=STM32G474RE DUALPORT=0

flash.ReProgram all /Erase
data.load.elf &elf_file
flash.ReProgram off

Data.LOAD.elf &elf_file /DIFF
IF FOUND()
  PRINT "Verify error after FLASH programming"
ELSE
  PRINT "FLASH programming completed successfully"

SYStem.Up

; Some preferred ITM settings
itm.clock 170MHz
tpiu.PortSize SWV
trace.TraceCLOCK 170MHz
itm.InterruptTrace ON
;itm.ON

itm.DataTrace off
itm.CycleAccurate ON

; trace.chart.interrupt

