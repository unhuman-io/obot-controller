&elf_file="~/obot/obot-controller/motorlib/bootloader/stm32g4/build/stm32g4_bootloader.elf"
&elf_file_app="~/obot/obot-controller/obot_g474/build/tmotor_driver.elf"
;reset

system.cpu stm32g474re
system.jtagclock 40MHz
SYStem.CONFIG.DEBUGPORTTYPE SWD
system.Option.EnReset OFF
system.Option.DUALPORT ON
system.mode attach
break
system.resettarget

do ~~/demo/arm/flash/stm32g4xx.cmm PREPAREONLY CPU=STM32G474RE DUALPORT=0

flash.ReProgram 0x8000000--0x80001fff /Erase
data.load.elf &elf_file
flash.ReProgram off
Data.LOAD.elf &elf_file /DIFF
IF FOUND()
  PRINT "Verify error after FLASH programming"
ELSE
  PRINT "FLASH programming completed successfully"

flash.ReProgram 0x8002000--0x807fffff
data.load.elf &elf_file_app
flash.ReProgram off
Data.LOAD.elf &elf_file_app /DIFF
IF FOUND()
  PRINT "Verify error after FLASH programming"
ELSE
  PRINT "FLASH programming completed successfully"

system.Option.IMASKASM ON

SYStem.Up

; Some preferred ITM settings
itm.clock 170MHz
tpiu.PortSize SWV
tpiu.SWVPrescaler 4.
trace.TraceCLOCK 42.5MHz
;itm.InterruptTrace ON
;itm.ON

itm.DataTrace off
;itm.CycleAccurate ON

system.RESetTarget
; trace.chart.interrupt

itm.TImeMode.PCSampler

TrOnchip.set.corereset off

list.auto

